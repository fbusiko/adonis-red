## CMakeLists.txt
```
# SPDX-License-Identifier: Apache-2.0

cmake_minimum_required(VERSION 3.13.1)
find_package(Zephyr REQUIRED HINTS $ENV{ZEPHYR_BASE})
project(thingy52)

# target_sources(app PRIVATE src/main.c)

target_sources(app PRIVATE src/main.c)
```

## prj.conf
```kconfig
CONFIG_BT=y
CONFIG_BT_OBSERVER=y
CONFIG_BT_BROADCASTER=y
CONFIG_BT_DEBUG_LOG=y
CONFIG_GPIO=y
CONFIG_BT_DEVICE_NAME="moble_node"
CONFIG_BT_WHITELIST=y

CONFIG_PRINTK=y
CONFIG_SHELL=y
CONFIG_LOG=y
CONFIG_INIT_STACKS=y
CONFIG_THREAD_STACK_INFO=y
CONFIG_KERNEL_SHELL=y
CONFIG_THREAD_MONITOR=y
CONFIG_BOOT_BANNER=n
CONFIG_THREAD_NAME=y
CONFIG_DEVICE_SHELL=y
CONFIG_POSIX_CLOCK=y
CONFIG_DATE_SHELL=y
CONFIG_THREAD_RUNTIME_STATS=y


CONFIG_USB=y
CONFIG_USB_DEVICE_STACK=y
CONFIG_USB_DEVICE_PRODUCT="Zephyr USB console sample"
CONFIG_USB_UART_CONSOLE=y
CONFIG_UART_INTERRUPT_DRIVEN=y
CONFIG_UART_LINE_CTRL=y
CONFIG_UART_SHELL_ON_DEV_NAME="CDC_ACM_0"
CONFIG_SHELL_BACKEND_SERIAL_INIT_PRIORITY=51
```

## boards/particle_argon.overlay
```dts
/* Add I2C1 support on Particle Mesh via nRF52840 TWI1
 *
 * NOTE: This file is replicated in particle_{argon,xenon}.
 * Changes should be made in all instances. */
&i2c1 { /* feather I2C1 */
	status = "okay";
	sda-pin = <33>;
	scl-pin = <34>;
};
```

## src/main.c
```c
/**
 ***************************************************************
 * @file apps/p1/src/main.c
 * @author Nicholas - s4537166
 * @date 01032021
 * @brief practical 1 main file
 ***************************************************************
 * EXTERNAL FUNCTIONS
 ***************************************************************
 * 
 ***************************************************************
*/
#include <zephyr.h>
#include <device.h>
#include <devicetree.h>
#include <drivers/gpio.h>

#include <zephyr/types.h>
#include <stddef.h>
#include <sys/printk.h>
#include <sys/util.h>
#include <usb/usb_device.h>
#include <drivers/uart.h>

#include <bluetooth/bluetooth.h>
#include <bluetooth/hci.h>
#include "cli_gps.c"

/* 1000 msec = 1 sec */
#define SLEEP_TIME_MS   1000

#define DEVICE_NAME CONFIG_BT_DEVICE_NAME
#define DEVICE_NAME_LEN (sizeof(DEVICE_NAME) - 1)

/* The devicetree node identifier for the "led0" alias. */
#define LED0_NODE DT_ALIAS(led0)

#if DT_NODE_HAS_STATUS(LED0_NODE, okay)
#define LED0	DT_GPIO_LABEL(LED0_NODE, gpios)
#define PIN	DT_GPIO_PIN(LED0_NODE, gpios)
#define FLAGS	DT_GPIO_FLAGS(LED0_NODE, gpios)
#else
/* A build error here means your board isn't set up to blink an LED. */
#error "Unsupported board: led0 devicetree alias is not defined"
#define LED0	""
#define PIN	0
#define FLAGS	0
#endif

#define LEN 10

static uint8_t node_info[LEN] = {
	0x01, 
	0x03,
	0x00, 
	0x00, 
	0x00, 
	0x00, 
	0x00, 
	0x00,
	0x00, 
	0x00
};

static const struct bt_data ad[] = {
	BT_DATA_BYTES(BT_DATA_FLAGS, (BT_LE_AD_GENERAL | BT_LE_AD_NO_BREDR)),
	BT_DATA(BT_DATA_NAME_COMPLETE, DEVICE_NAME, DEVICE_NAME_LEN),
	BT_DATA(BT_DATA_MANUFACTURER_DATA, node_info, LEN)
};

/* Set Scan Response data */
static const struct bt_data sd[] = {
	BT_DATA(BT_DATA_NAME_COMPLETE, DEVICE_NAME, DEVICE_NAME_LEN),
};

static void scan_cb(const bt_addr_le_t *addr, int8_t rssi, uint8_t adv_type,
		    struct net_buf_simple *buf) 
{

	if (buf->data[18] == 0x01 && buf->data[19] == 0x02) {

		if (buf->data[20] == 0x01) {

			node_info[4] = rssi;
		}
		if (buf->data[20] == 0x02) {

			node_info[5] = rssi;
		}
		if (buf->data[20] == 0x03) {

			node_info[6] = rssi;
		}
		if (buf->data[20] == 0x04) {

			node_info[7] = rssi;
		}
	}
}

void main(void) {

	const struct device *i2c;
	const struct device *led;
	bool led_is_on = false;
	int ret;

	led = device_get_binding(LED0);
	if (led == NULL) {
		return;
	}

	ret = gpio_pin_configure(led, PIN, GPIO_OUTPUT_ACTIVE | FLAGS);
	if (ret < 0) {
		return;
	}
	
	struct bt_le_scan_param scan_param = {
		.type       = BT_HCI_LE_SCAN_PASSIVE,
		.options    = BT_LE_SCAN_OPT_NONE,
		.interval   = 0x0010,
		.window     = 0x0010,
	};
	int err;

	/* Initialize the Bluetooth Subsystem */
	err = bt_enable(NULL);
	if (err) {
		printk("Bluetooth init failed (err %d)\n", err);
		return;
	}

	err = bt_le_scan_start(&scan_param, scan_cb);
	if (err) {
		printk("Starting scanning failed (err %d)\n", err);
		return;
	}
	const struct device *dev;
	uint32_t dtr = 0;

	#if defined(CONFIG_USB_UART_CONSOLE)
	dev = device_get_binding(CONFIG_UART_SHELL_ON_DEV_NAME);
	if (dev == NULL || usb_enable(NULL)) {
		return;
	}
	#endif

	while(1) {

		/* Start advertising */
		// && node_2_status && node_3_status && node_4_status

		err = bt_le_adv_start(BT_LE_ADV_NCONN, ad, ARRAY_SIZE(ad),
					NULL, 0);
		if (err) {
			printk("Advertising failed to start (err %d)\n", err);
			return;
		}

		k_sleep(K_MSEC(400));

		err = bt_le_adv_stop();
		if (err) {
			printk("Advertising failed to stop (err %d)\n", err);
			return;
		}
		
		k_sleep(K_MSEC(1000));

		gpio_pin_set(led, PIN, (int)led_is_on);
		led_is_on = !led_is_on;
		
	}
}
```

## src/cli_gps.c
```c
/**
 ***************************************************************
 * @file myoslib/src/cli_i2c.c
 * @author Nicholas - s4537166
 * @date 15032021
 * @brief LED Light Bar peripheral driver
 ***************************************************************
 * EXTERNAL FUNCTIONS
 ***************************************************************
 * hal_ledbar_init () - intialise LED bar
 * hal_ledbar_set () - set LED bar value
 ***************************************************************
*/

#include <zephyr.h>
#include <shell/shell.h>
#include <devicetree.h>
#include <drivers/gpio.h>
#include <stdlib.h>


/* The devicetree node identifier for the "led0" alias. */
#define LED0_NODE DT_ALIAS(led0)

#if DT_NODE_HAS_STATUS(LED0_NODE, okay)
#define LED0	DT_GPIO_LABEL(LED0_NODE, gpios)
#define PIN	DT_GPIO_PIN(LED0_NODE, gpios)
#define FLAGS	DT_GPIO_FLAGS(LED0_NODE, gpios)
#else
/* A build error here means your board isn't set up to blink an LED. */
#error "Unsupported board: led0 devicetree alias is not defined"
#define LED0	""
#define PIN	0
#define FLAGS	0
#endif
/**
 * @brief Shell command that reads and writes any i2c register
 * 
 * This shell command will read and write to any i2c register using the HCI myoslib driver.
 * Only works with single bytes.
 */
static int cmd_i2creg(const struct shell *shell, size_t argc, char **argv) {

	const struct device *led;
	bool led_is_on = false;
	int ret;
	shell_print(shell, "test");

	led = device_get_binding(LED0);
	if (led == NULL) {
		return;
	}

	ret = gpio_pin_configure(led, PIN, GPIO_OUTPUT_ACTIVE | FLAGS);
	if (ret < 0) {
		return;
	}

	while(1) {

		gpio_pin_set(led, PIN, (int)led_is_on);
		led_is_on = !led_is_on;

	}

	return 0;
}

SHELL_CMD_ARG_REGISTER(i2creg, NULL, "Read/Write Sensor Regestors", cmd_i2creg, 4, 1);
```
